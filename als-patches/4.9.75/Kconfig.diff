## als-patches/4.9.75/Kconfig.diff
```kconfig
diff --git a/security/Kconfig b/security/Kconfig
index 4415de2fdde2..638afc868ba2 100644
--- a/security/Kconfig
+++ b/security/Kconfig
@@ -50,6 +50,16 @@ config SECURITY_WRITABLE_HOOKS
 	bool
 	default n
 
+config PAGE_TABLE_ISOLATION
+	bool "Remove the kernel mapping in user mode"
+	default y
+	depends on X86_64 && SMP
+	help
+	  This enforces a strict kernel and user space isolation, in order
+	  to close hardware side channels on kernel address information.
+
+	  If you are unsure how to answer this question, answer Y.
+
 config SECURITYFS
 	bool "Enable the securityfs filesystem"
 	help
```

## stable-patches/4.9.95/Kconfig.diff
```kconfig
diff --git a/arch/arm64/Kconfig b/arch/arm64/Kconfig
index 64e4a03d9d22..5941d33e98b0 100644
--- a/arch/arm64/Kconfig
+++ b/arch/arm64/Kconfig
@@ -795,6 +795,7 @@ config UNMAP_KERNEL_AT_EL0
 
 config HARDEN_BRANCH_PREDICTOR
 	bool "Harden the branch predictor against aliasing attacks" if EXPERT
+	default y
 	help
 	  Speculation attacks against some high-performance processors rely on
 	  being able to manipulate the branch predictor for a victim context by
```
